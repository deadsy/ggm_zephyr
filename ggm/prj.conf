## CMakeLists.txt
```
cmake_minimum_required(VERSION 3.13.1)

include($ENV{ZEPHYR_BASE}/cmake/app/boilerplate.cmake NO_POLICY_SCOPE)
project(NONE)

target_include_directories(app
	PRIVATE
		src/inc
		src/module
)

target_sources(app
	PRIVATE
		src/core/block.c
		src/core/event.c
		src/core/lut.c
		src/core/math.c
		src/core/midi.c
		src/core/module.c
		src/core/port.c
		src/core/synth.c
		src/core/util.c
		src/module/template.c
		src/module/delay/delay.c
		src/module/env/adsr.c
		src/module/filter/biquad.c
		src/module/filter/svf.c
		src/module/midi/mono.c
		src/module/midi/poly.c
		src/module/mix/pan.c
		src/module/osc/goom.c
		src/module/osc/ks.c
		src/module/osc/lfo.c
		src/module/osc/noise.c
		src/module/osc/sine.c
		src/module/pm/breath.c
		src/module/root/metro.c
		src/module/root/poly.c
		src/module/seq/seq.c
		src/module/voice/goom.c
		src/module/voice/osc.c
		src/os/zephyr/zephyr.c
		src/os/zephyr/main.c
)
```

## prj.conf
```kconfig
# Generated by Kconfiglib (https://github.com/ulfalizer/Kconfiglib)
CONFIG_FLOAT=y
CONFIG_HEAP_MEM_POOL_SIZE=32768
CONFIG_HEAP_MEM_POOL_MIN_SIZE=64
CONFIG_LOG=y
CONFIG_LOG_ENABLE_FANCY_OUTPUT_FORMATTING=y
CONFIG_LOG_FUNC_NAME_PREFIX_ERR=y
CONFIG_LOG_FUNC_NAME_PREFIX_WRN=y
CONFIG_LOG_FUNC_NAME_PREFIX_INF=y
```

## src/main.c
```c
/*
 * Copyright (c) 2019 Jason T. Harris. (sirmanlypowers@gmail.com)
 *
 * SPDX-License-Identifier: Apache-2.0
 */

#include <zephyr.h>
#include <sys/printk.h>

#include "ggm.h"

#define GGM_VERSION "0.1"

void foo(void);

void main(void)
{
	char tmp[128];
	uint32_t state;

	printk("GooGooMuck %s (%s)\n", GGM_VERSION, CONFIG_BOARD);
	rand_init(1234, &state);
	for (int i = 0; i < 100; i++) {
		float x = randf(&state);
		printk("%s %08x\n", ftoa(x, tmp), float2uint(x));
	}
}
```

## src/block.c
```c
/*
 * Copyright (c) 2019 Jason T. Harris. (sirmanlypowers@gmail.com)
 *
 * SPDX-License-Identifier: Apache-2.0
 */

#include <stddef.h>

#include "ggm.h"

/******************************************************************************
 * Block Operations
 * Note: Unrolling these loops and breaking up the operations tends to speed them
 * up because it gives the compiler a chance to pipeline loads and stores.
 * I haven't tried anything fancy with the order of operations within the loop
 * because the compiler will re-order them as it sees fit.
 *
 * The block_mul/add() function seem immune to improvements. They use vldmia/vstmia
 * and it maybe that other functions could benefit from multiple load/store also.
 */

/* multiply two buffers */
void block_mul(float *out, float *buf, size_t n)
{
	for (size_t i = 0; i < n; i++) {
		out[i] *= buf[i];
	}
}

/* add two buffers */
void block_add(float *out, float *buf, size_t n)
{
	for (size_t i = 0; i < n; i++) {
		out[i] += buf[i];
	}
}

/* multiply a block by a scalar */
void block_mul_k(float *out, float k, size_t n)
{
	/* unroll x4 */
	while (n > 0) {
		out[0] *= k;
		out[1] *= k;
		out[2] *= k;
		out[3] *= k;
		out += 4;
		n -= 4;
	}
}

/* add a scalar to a buffer */
void block_add_k(float *out, float k, size_t n)
{
	/* unroll x4 */
	while (n > 0) {
		out[0] += k;
		out[1] += k;
		out[2] += k;
		out[3] += k;
		out += 4;
		n -= 4;
	}
}

/* copy a block */
void block_copy(float *dst, const float *src, size_t n)
{
	/* unroll x4 */
	while (n > 0) {
		dst[0] = src[0];
		dst[1] = src[1];
		dst[2] = src[2];
		dst[3] = src[3];
		src += 4;
		dst += 4;
		n -= 4;
	}
}

/* copy a block and multiply by k */
void block_copy_mul_k(float *dst, const float *src, float k, size_t n)
{
	/* unroll x4 */
	while (n > 0) {
		dst[0] = src[0] * k;
		dst[1] = src[1] * k;
		dst[2] = src[2] * k;
		dst[3] = src[3] * k;
		src += 4;
		dst += 4;
		n -= 4;
	}
}
```

## src/const.h
```c
/*
 * Copyright (c) 2019 Jason T. Harris. (sirmanlypowers@gmail.com)
 *
 * SPDX-License-Identifier: Apache-2.0
 */

#ifndef GGM_SRC_CONST_H
#define GGM_SRC_CONST_H

/******************************************************************************
 * Constants
 */

/* Pi (3.14159...) */
#define Pi (3.1415926535897932384626433832795f)

/* Tau (2 * Pi) */
#define Tau (2.f * Pi)

/* AudioSampleFrequency is the sample frequency for audio (Hz) */
#define AudioSampleFrequency (48000U)

/* AudioSamplePeriod is the sample period for audio (seconds) */
#define AudioSamplePeriod (1.f / (float)AudioSampleFrequency)

/* AudioBufferSize is the number of float samples per audio buffer */
#define AudioBufferSize (128U)

/* SecsPerAudioBuffer is the audio duration for a single audio buffer */
#define SecsPerAudioBuffer ((float)AudioBufferSize / (float)AudioSampleFrequency)

/* FullCycle is a full uint32_t phase count */
#define FullCycle (1ULL << 32)

/* HalfCycle is a half uint32_t phase count */
#define HalfCycle (1U << 31)

/* QuarterCycle is a quarter uint32_t phase count */
#define QuarterCycle (1U << 30)

/* FrequencyScale scales a frequency value to a uint32_t phase step value */
#define FrequencyScale ((float)FullCycle / (float)AudioSampleFrequency)

/* PhaseScale scales a phase value to a uint32_t phase step value */
#define PhaseScale ((float)FullCycle / Tau)

#endif /* GGM_SRC_CONST_H */
```

## src/ggm.h
```c
/*
 * Copyright (c) 2019 Jason T. Harris. (sirmanlypowers@gmail.com)
 *
 * SPDX-License-Identifier: Apache-2.0
 */

#ifndef GGM_SRC_GGM_H
#define GGM_SRC_GGM_H

#include <stddef.h>
#include <inttypes.h>

/******************************************************************************
 * Constants
 */

/* Pi (3.14159...) */
#define Pi (3.1415926535897932384626433832795f)

/* Tau (2 * Pi) */
#define Tau (2.f * Pi)

/* AudioSampleFrequency is the sample frequency for audio (Hz) */
#define AudioSampleFrequency (48000U)

/* AudioSamplePeriod is the sample period for audio (seconds) */
#define AudioSamplePeriod (1.f / (float)AudioSampleFrequency)

/* AudioBufferSize is the number of float samples per audio buffer */
#define AudioBufferSize (128U)

/* SecsPerAudioBuffer is the audio duration for a single audio buffer */
#define SecsPerAudioBuffer ((float)AudioBufferSize / (float)AudioSampleFrequency)

/* FullCycle is a full uint32_t phase count */
#define FullCycle (1ULL << 32)

/* HalfCycle is a half uint32_t phase count */
#define HalfCycle (1U << 31)

/* QuarterCycle is a quarter uint32_t phase count */
#define QuarterCycle (1U << 30)

/* FrequencyScale scales a frequency value to a uint32_t phase step value */
#define FrequencyScale ((float)FullCycle / (float)AudioSampleFrequency)

/* PhaseScale scales a phase value to a uint32_t phase step value */
#define PhaseScale ((float)FullCycle / Tau)

/******************************************************************************
 * Lookup Table Functions
 */

float cos_lookup(uint32_t x);
float pow2(float x);

/******************************************************************************
 * 32-bit float math functions.
 */

float truncf(float x);
float fabsf(float x);

int isinff(float x);
int isnanf(float x);

float cosf(float x);
float sinf(float x);
float tanf(float x);

float powe(float x);

/******************************************************************************
 * 32-bit float to string conversion
 */

char *ftoa(float val, char *buf);
int float2str(float val, char *buf);

/******************************************************************************
 * block operations
 */

void block_mul(float *out, float *buf, size_t n);
void block_mul_k(float *out, float k, size_t n);
void block_add(float *out, float *buf, size_t n);
void block_add_k(float *out, float k, size_t n);
void block_copy(float *dst, const float *src, size_t n);
void block_copy_mul_k(float *dst, const float *src, float k, size_t n);

/******************************************************************************
 * sub-includes
 */

#include "utils.h"

#endif /* GGM_SRC_GGM_H */
```

## src/lut.c
```c
/*
 * Copyright (c) 2019 Jason T. Harris. (sirmanlypowers@gmail.com)
 *
 * SPDX-License-Identifier: Apache-2.0
 */

#include "ggm.h"

/******************************************************************************
 * LUT based cosine function - generated by ./tools/lut.py
 */

#define COS_LUT_BITS (7U)
#define COS_LUT_SIZE (1U << COS_LUT_BITS)

static const float COS_LUT_data[COS_LUT_SIZE << 1] = {
	1.000000e+00, -1.204544e-03, 9.987955e-01, -3.610730e-03, 9.951847e-01, -6.008217e-03, 9.891765e-01, -8.391230e-03,
	9.807853e-01, -1.075403e-02, 9.700313e-01, -1.309092e-02, 9.569403e-01, -1.539627e-02, 9.415441e-01, -1.766453e-02,
	9.238795e-01, -1.989024e-02, 9.039893e-01, -2.206803e-02, 8.819213e-01, -2.419265e-02, 8.577286e-01, -2.625900e-02,
	8.314696e-01, -2.826208e-02, 8.032075e-01, -3.019708e-02, 7.730105e-01, -3.205933e-02, 7.409511e-01, -3.384434e-02,
	7.071068e-01, -3.554783e-02, 6.715590e-01, -3.716567e-02, 6.343933e-01, -3.869398e-02, 5.956993e-01, -4.012907e-02,
	5.555702e-01, -4.146749e-02, 5.141027e-01, -4.270601e-02, 4.713967e-01, -4.384164e-02, 4.275551e-01, -4.487166e-02,
	3.826834e-01, -4.579358e-02, 3.368899e-01, -4.660518e-02, 2.902847e-01, -4.730450e-02, 2.429802e-01, -4.788986e-02,
	1.950903e-01, -4.835985e-02, 1.467305e-01, -4.871333e-02, 9.801714e-02, -4.894947e-02, 4.906767e-02, -4.906767e-02,
	6.123234e-17, -4.906767e-02, -4.906767e-02, -4.894947e-02, -9.801714e-02, -4.871333e-02, -1.467305e-01, -4.835985e-02,
	-1.950903e-01, -4.788986e-02, -2.429802e-01, -4.730450e-02, -2.902847e-01, -4.660518e-02, -3.368899e-01, -4.579358e-02,
	-3.826834e-01, -4.487166e-02, -4.275551e-01, -4.384164e-02, -4.713967e-01, -4.270601e-02, -5.141027e-01, -4.146749e-02,
	-5.555702e-01, -4.012907e-02, -5.956993e-01, -3.869398e-02, -6.343933e-01, -3.716567e-02, -6.715590e-01, -3.554783e-02,
	-7.071068e-01, -3.384434e-02, -7.409511e-01, -3.205933e-02, -7.730105e-01, -3.019708e-02, -8.032075e-01, -2.826208e-02,
	-8.314696e-01, -2.625900e-02, -8.577286e-01, -2.419265e-02, -8.819213e-01, -2.206803e-02, -9.039893e-01, -1.989024e-02,
	-9.238795e-01, -1.766453e-02, -9.415441e-01, -1.539627e-02, -9.569403e-01, -1.309092e-02, -9.700313e-01, -1.075403e-02,
	-9.807853e-01, -8.391230e-03, -9.891765e-01, -6.008217e-03, -9.951847e-01, -3.610730e-03, -9.987955e-01, -1.204544e-03,
	-1.000000e+00, 1.204544e-03, -9.987955e-01, 3.610730e-03, -9.951847e-01, 6.008217e-03, -9.891765e-01, 8.391230e-03,
	-9.807853e-01, 1.075403e-02, -9.700313e-01, 1.309092e-02, -9.569403e-01, 1.539627e-02, -9.415441e-01, 1.766453e-02,
	-9.238795e-01, 1.989024e-02, -9.039893e-01, 2.206803e-02, -8.819213e-01, 2.419265e-02, -8.577286e-01, 2.625900e-02,
	-8.314696e-01, 2.826208e-02, -8.032075e-01, 3.019708e-02, -7.730105e-01, 3.205933e-02, -7.409511e-01, 3.384434e-02,
	-7.071068e-01, 3.554783e-02, -6.715590e-01, 3.716567e-02, -6.343933e-01, 3.869398e-02, -5.956993e-01, 4.012907e-02,
	-5.555702e-01, 4.146749e-02, -5.141027e-01, 4.270601e-02, -4.713967e-01, 4.384164e-02, -4.275551e-01, 4.487166e-02,
	-3.826834e-01, 4.579358e-02, -3.368899e-01, 4.660518e-02, -2.902847e-01, 4.730450e-02, -2.429802e-01, 4.788986e-02,
	-1.950903e-01, 4.835985e-02, -1.467305e-01, 4.871333e-02, -9.801714e-02, 4.894947e-02, -4.906767e-02, 4.906767e-02,
	-1.836970e-16, 4.906767e-02, 4.906767e-02, 4.894947e-02, 9.801714e-02, 4.871333e-02, 1.467305e-01, 4.835985e-02,
	1.950903e-01, 4.788986e-02, 2.429802e-01, 4.730450e-02, 2.902847e-01, 4.660518e-02, 3.368899e-01, 4.579358e-02,
	3.826834e-01, 4.487166e-02, 4.275551e-01, 4.384164e-02, 4.713967e-01, 4.270601e-02, 5.141027e-01, 4.146749e-02,
	5.555702e-01, 4.012907e-02, 5.956993e-01, 3.869398e-02, 6.343933e-01, 3.716567e-02, 6.715590e-01, 3.554783e-02,
	7.071068e-01, 3.384434e-02, 7.409511e-01, 3.205933e-02, 7.730105e-01, 3.019708e-02, 8.032075e-01, 2.826208e-02,
	8.314696e-01, 2.625900e-02, 8.577286e-01, 2.419265e-02, 8.819213e-01, 2.206803e-02, 9.039893e-01, 1.989024e-02,
	9.238795e-01, 1.766453e-02, 9.415441e-01, 1.539627e-02, 9.569403e-01, 1.309092e-02, 9.700313e-01, 1.075403e-02,
	9.807853e-01, 8.391230e-03, 9.891765e-01, 6.008217e-03, 9.951847e-01, 3.610730e-03, 9.987955e-01, 1.204544e-03,
};

#define FRAC_BITS (32U - COS_LUT_BITS)
#define FRAC_MASK ((1U << FRAC_BITS) - 1)
#define FRAC_SCALE (1.f / (float)FRAC_MASK)

float cos_lookup(uint32_t x)
{
	uint32_t idx = (x >> FRAC_BITS) << 1;
	float frac = (x & FRAC_MASK) * FRAC_SCALE;
	float y = COS_LUT_data[idx];
	float dy = COS_LUT_data[idx + 1];

	return y + (dy * frac);
}

/******************************************************************************
 * LUT based exponential functions
 */

/* Generated by ./tools/exp.py */

static const uint16_t exp0_table[64] = {
	0x8000, 0x8165, 0x82ce, 0x843a, 0x85ab, 0x871f, 0x8898, 0x8a15, 0x8b96, 0x8d1b, 0x8ea4, 0x9032, 0x91c4, 0x935a, 0x94f5, 0x9694,
	0x9838, 0x99e0, 0x9b8d, 0x9d3f, 0x9ef5, 0xa0b0, 0xa270, 0xa435, 0xa5ff, 0xa7ce, 0xa9a1, 0xab7a, 0xad58, 0xaf3b, 0xb124, 0xb312,
	0xb505, 0xb6fe, 0xb8fc, 0xbaff, 0xbd09, 0xbf18, 0xc12c, 0xc347, 0xc567, 0xc78d, 0xc9ba, 0xcbec, 0xce25, 0xd063, 0xd2a8, 0xd4f3,
	0xd745, 0xd99d, 0xdbfc, 0xde61, 0xe0cd, 0xe340, 0xe5b9, 0xe839, 0xeac1, 0xed4f, 0xefe5, 0xf281, 0xf525, 0xf7d1, 0xfa84, 0xfd3e,
};

static const uint16_t exp1_table[64] = {
	0x8000, 0x8006, 0x800b, 0x8011, 0x8016, 0x801c, 0x8021, 0x8027, 0x802c, 0x8032, 0x8037, 0x803d, 0x8043, 0x8048, 0x804e, 0x8053,
	0x8059, 0x805e, 0x8064, 0x806a, 0x806f, 0x8075, 0x807a, 0x8080, 0x8085, 0x808b, 0x8090, 0x8096, 0x809c, 0x80a1, 0x80a7, 0x80ac,
	0x80b2, 0x80b8, 0x80bd, 0x80c3, 0x80c8, 0x80ce, 0x80d3, 0x80d9, 0x80df, 0x80e4, 0x80ea, 0x80ef, 0x80f5, 0x80fa, 0x8100, 0x8106,
	0x810b, 0x8111, 0x8116, 0x811c, 0x8122, 0x8127, 0x812d, 0x8132, 0x8138, 0x813e, 0x8143, 0x8149, 0x814e, 0x8154, 0x815a, 0x815f,
};

/* pow2_int returns powf(2.f, x) where x is an integer [-126,127] */
static float pow2_int(int x)
{
	union {
		unsigned int ui;
		float f;
	} val;

	/* make a float per IEEE754 */
	val.ui = (127 + x) << 23;
	return val.f;
}

/* pow2_frac returns powf(2.f, x) where x = [0,1) */
static float pow2_frac(float x)
{
	int n = (int)(x * (float)(1U << 12));
	uint16_t x0 = exp0_table[(n >> 6) & 0x3f];
	uint16_t x1 = exp1_table[n & 0x3f];

	return (float)(x0 * x1) * (1.f / (float)(1U << 30));
}

/* pow2 returns powf(2.f, x) */
float pow2(float x)
{
	float nf = truncf(x);
	float ff = x - nf;

	if (ff < 0) {
		nf -= 1.f;
		ff += 1.f;
	}
	return pow2_frac(ff) * pow2_int((int)nf);
}
```

## src/lut.h
```c
/*
 * Copyright (c) 2019 Jason T. Harris. (sirmanlypowers@gmail.com)
 *
 * SPDX-License-Identifier: Apache-2.0
 */

#ifndef GGM_SRC_LUT_H
#define GGM_SRC_LUT_H

/******************************************************************************
 * Prototypes
 */

float cos_lookup(uint32_t x);
float cos_eval(float x);
float sin_eval(float x);
float tan_eval(float x);

#endif /* GGM_SRC_LUT_H */
```

## src/math.c
```c
/*
 * Copyright (c) 2019 Jason T. Harris. (sirmanlypowers@gmail.com)
 *
 * SPDX-License-Identifier: Apache-2.0
 */

#include "ggm.h"

/******************************************************************************
 * 32-bit float helper macros
 */

/* A union which permits us to convert between a float and a 32 bit int.  */
typedef union {
	float value;
	uint32_t word;
} ieee_float_shape_type;

/* Get a 32 bit int from a float.  */
#define GET_FLOAT_WORD(i, d)		    \
	do {				    \
		ieee_float_shape_type gf_u; \
		gf_u.value = (d);	    \
		(i) = gf_u.word;	    \
	} while (0)

/* Set a float from a 32 bit int.  */
#define SET_FLOAT_WORD(d, i)		    \
	do {				    \
		ieee_float_shape_type sf_u; \
		sf_u.word = (i);	    \
		(d) = sf_u.value;	    \
	} while (0)

#define FLT_UWORD_IS_NAN(x) ((x) > 0x7f800000L)
#define FLT_UWORD_IS_INFINITE(x) ((x) == 0x7f800000L)

/******************************************************************************
 * 32-bit float truncation.
 */

float truncf(float x)
{
	int32_t signbit, w, exponent_less_127;

	GET_FLOAT_WORD(w, x);

	/* Extract sign bit. */
	signbit = w & 0x80000000;

	/* Extract exponent field. */
	exponent_less_127 = ((w & 0x7f800000) >> 23) - 127;

	if (exponent_less_127 < 23) {
		if (exponent_less_127 < 0) {
			/* -1 < x < 1, so result is +0 or -0. */
			SET_FLOAT_WORD(x, signbit);
		} else {
			SET_FLOAT_WORD(x, signbit | (w & ~(0x007fffff >> exponent_less_127)));
		}
	} else {
		if (exponent_less_127 == 255) {
			/* x is NaN or infinite. */
			return x + x;
		}

		/* All bits in the fraction field are relevant. */
	}
	return x;
}

/******************************************************************************
 * 32-bit float absolute values
 */

float fabsf(float x)
{
	union {
		unsigned int ui;
		float f;
	} val;

	val.f = x;
	val.ui = (val.ui << 1) >> 1;
	return val.f;
}

/******************************************************************************
 * is not-a-number
 */

int isnanf(float x)
{
	int32_t ix;

	GET_FLOAT_WORD(ix, x);
	ix &= 0x7fffffff;
	return FLT_UWORD_IS_NAN(ix);
}

/******************************************************************************
 * is infinite
 */

int isinff(float x)
{
	int32_t ix;

	GET_FLOAT_WORD(ix, x);
	ix &= 0x7fffffff;
	return FLT_UWORD_IS_INFINITE(ix);
}

/******************************************************************************
 * 32-bit float trigonometry functions
 * These are LUT based and are less accurate but faster than typical libm functions.
 */

float cosf(float x)
{
	uint32_t xi = (uint32_t) (fabsf(x) * PhaseScale);

	return cos_lookup(xi);
}

float sinf(float x)
{
	uint32_t xi = QuarterCycle - (uint32_t) (fabsf(x) * PhaseScale);

	return cos_lookup(xi);
}

float tanf(float x)
{
	return sinf(x) / cosf(x);
}

/******************************************************************************
 * 32-bit float power function
 * powe returns powf(e, x)
 */

#define LOG_E2 (1.4426950408889634f)    /* 1.0 / math.log(2.0) */

float powe(float x)
{
	return pow2(LOG_E2 * x);
}
```

## src/math.h
```c
/*
 * Copyright (c) 2019 Jason T. Harris. (sirmanlypowers@gmail.com)
 *
 * SPDX-License-Identifier: Apache-2.0
 */

#ifndef GGM_SRC_MATH_H
#define GGM_SRC_MATH_H

/******************************************************************************
 * Prototypes
 */

float truncf(float x);
float fabsf(float x);
float cosf(float x);
float sinf(float x);
float tanf(float x);
float powe(float x);

#endif /* GGM_SRC_MATH_H */
```

## src/utils.h
```c
/*
 * Copyright (c) 2019 Jason T. Harris. (sirmanlypowers@gmail.com)
 *
 * SPDX-License-Identifier: Apache-2.0
 */

#ifndef GGM_SRC_UTILS_H
#define GGM_SRC_UTILS_H

#ifndef GGM_SRC_GGM_H
#warning "please include this file using the toplevel ggm.h"
#endif

/******************************************************************************
 * radian/degree conversion
 */

/* d2r converts degrees to radians */
static inline float d2r(float d)
{
	return d * (Pi / 180.f);
}

/* r2d converts radians to degrees */
static inline float r2d(float r)
{
	return r * (180.f / Pi);
}

/******************************************************************************
 * clamp floating point values
 */

/* clamp x between a and b */
static inline float clampf(float x, float a, float b)
{
	if (x < a) {
		return a;
	}
	if (x > b) {
		return b;
	}
	return x;
}

/* clamp x to >= a */
static inline float clampf_lo(float x, float a)
{
	return (x < a) ? a : x;
}

/* clamp x to <= a */
static inline float clampf_hi(float x, float a)
{
	return (x > a) ? a : x;
}

/******************************************************************************
 * linear mapping map x = 0..1 to y = a..b
 */

static inline float mapf(float x, float a, float b)
{
	return ((b - a) * x) + a;
}

/******************************************************************************
 * Simple random number generation
 * Based on a linear congruential generator.
 */

/* set an initial value for the random state */
static inline void rand_init(uint32_t seed, uint32_t *state)
{
	if (seed == 0) {
		seed = 1;
	}
	*state = seed;
}

/* return a random uint32_t (0..0x7fffffff) */
static inline uint32_t rand_uint32(uint32_t *state)
{
	*state = ((*state * 1103515245) + 12345) & 0x7fffffff;
	return *state;
}

/* return a float from -1..1 */
static inline float randf(uint32_t *state)
{
	union {
		uint32_t ui;
		float f;
	} val;

	val.ui = (rand_uint32(state) & 0x007fffff) | (128 << 23);       /* 2..4 */
	return val.f - 3.f;                                             /* -1..1 */
}

/******************************************************************************
 * float to uint32_t conversion
 */

static inline uint32_t float2uint(float x)
{
	union {
		uint32_t ui;
		float f;
	} val;

	val.f = x;
	return val.ui;
}

#endif /* GGM_SRC_UTILS_H */
```
